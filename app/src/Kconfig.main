## app/src/Kconfig.main
```kconfig
#
# Copyright (c) 2023 Nordic Semiconductor
#
# SPDX-License-Identifier: LicenseRef-Nordic-5-Clause
#
menu "App"

config APP_SAMPLING_INTERVAL_SECONDS
	int "Sampling interval"
	default 600
	help
	  Interval in seconds that determines how often sensor and location data is
	  collected.

config APP_SAMPLING_INTERVAL_ACTIVE_SECONDS
	int "Sampling interval while in motion"
	default 60
	help
	  Sampling interval used while the impact module (if enabled) detects
	  the device is in motion. Overrides APP_SAMPLING_INTERVAL_SECONDS
	  until a sustained period of stillness is detected again (see
	  CONFIG_APP_IMPACT_MOTION_STILL_TIMEOUT_SECONDS).

config APP_PANIC
	bool "Panic mode (press the button several times)"
	depends on APP_BUTTON
	default y
	help
	  Pressing button 1 CONFIG_APP_BUTTON_PANIC_PRESSES times quickly starts panic
	  mode: a PANIC message is sent to the cloud right away and repeated, location
	  and sensors are sampled at the panic interval, and every sample is sent at once.
	  The same gesture again ends it, otherwise it ends by itself after
	  CONFIG_APP_PANIC_DURATION_MINUTES.

config APP_PANIC_SAMPLING_INTERVAL_SECONDS
	int "Sampling interval in panic mode"
	default 30
	depends on APP_PANIC

config APP_PANIC_DURATION_MINUTES
	int "Panic mode ends by itself after this many minutes"
	default 30
	depends on APP_PANIC

config APP_PANIC_BEACON_SECONDS
	int "How often the PANIC message is repeated while in panic mode"
	default 20
	depends on APP_PANIC

config APP_WATCHDOG_TIMEOUT_SECONDS
	int "Watchdog timeout"
	default 180
	help
	  Timeout in seconds for the main module watchdog.
	  The timeout given in this option covers both:
	    * Waiting for an incoming message in zbus_sub_wait_msg().
	    * Time spent processing the message, defined by
	      CONFIG_APP_MSG_PROCESSING_TIMEOUT_SECONDS.
	  Ensure that this value exceeds CONFIG_APP_MSG_PROCESSING_TIMEOUT_SECONDS.
	  A small difference between the two can mean more frequent watchdog feeds, which increases
	  power consumption.

config APP_MSG_PROCESSING_TIMEOUT_SECONDS
	int "Maximum message processing time"
	default 120
	help
	  Maximum time allowed for processing a single message in the module's state machine.
	  The value must be smaller than CONFIG_APP_WATCHDOG_TIMEOUT_SECONDS.

module = APP
module-str = APP
source "subsys/logging/Kconfig.template.log_config"

endmenu
```

## app/src/modules/impact/Kconfig.impact
```kconfig
#
# Copyright (c) 2026 Nordic Semiconductor ASA
#
# SPDX-License-Identifier: LicenseRef-Nordic-5-Clause
#

menuconfig APP_IMPACT
	bool "Impact detection module"
	depends on ADXL362 || ADXL367
	default n

if APP_IMPACT

config APP_IMPACT_THREAD_STACK_SIZE
	int "Thread stack size"
	default 1280

config APP_IMPACT_SAMPLE_INTERVAL_MS
	int "Accelerometer sample interval in milliseconds"
	default 20
	help
	  How often the accelerometer is polled for impact detection. Kept
	  short (fast) relative to orientation/pedometer sampling so that a
	  short shock pulse isn't missed or under-measured between samples.

config APP_IMPACT_THRESHOLD_MG
	int "Impact detection threshold in milli-g"
	default 8000
	help
	  Peak acceleration magnitude, in thousandths of g, that triggers an
	  impact event. Default is 8000 (8.0 g). This is a starting point, not
	  a calibrated value - see the project notes on tuning it against
	  real logged peak-g data from normal activity.

config APP_IMPACT_CAPTURE_WINDOW_MS
	int "Peak capture window in milliseconds"
	default 100
	help
	  Once the threshold is crossed, the module keeps sampling for this
	  long and reports the highest g value seen in that window, rather
	  than just the first over-threshold sample - the true peak of a
	  shock event can land a sample or two after the initial crossing.

config APP_IMPACT_DEBOUNCE_MS
	int "Debounce time in milliseconds after a reported impact"
	default 3000
	help
	  Minimum time after a reported impact event before another one can
	  be detected. Prevents one physical event (e.g. bouncing after a
	  fall) from generating a flood of separate impact reports/pushes.
config APP_IMPACT_MOTION_THRESHOLD_MG
        int "Motion detection threshold in milli-g"
        default 80
        help
          Peak-to-peak acceleration variation, in thousandths of g, within a
          roughly 1 second window, that is considered evidence of motion
          (walking, riding in a vehicle, general vibration) as opposed to
          being stationary. This is independent of the impact-detection
          threshold above - much smaller, since it only needs to catch
          "something is moving", not "something hit hard".
config APP_IMPACT_MOTION_STILL_TIMEOUT_SECONDS
        int "Seconds of no motion before reverting to the normal sampling interval"
        default 120
        help
          How long the device must show no motion (per
          CONFIG_APP_IMPACT_MOTION_THRESHOLD_MG) before it is considered
          stationary again, at which point the sampling interval reverts from
          CONFIG_APP_SAMPLING_INTERVAL_ACTIVE_SECONDS back to
          CONFIG_APP_SAMPLING_INTERVAL_SECONDS.
config APP_IMPACT_LIFT_DETECT
        bool "Treat a lift (elevator) ride as movement"
        default y
        help
          A lift ride is smooth, so the peak-to-peak motion test above sees
          almost nothing and the tracker would relax back to the slow
          sampling interval in the middle of the ride. A lift does change the
          size of the acceleration vector for a second or two (vertical
          acceleration at the start and end of the ride; tilting or
          sideways acceleration barely changes it). When a quiet ~1 second
          window has a mean that differs from the recent baseline by at least
          CONFIG_APP_IMPACT_LIFT_DEV_MG, the tracker counts it as a lift and
          keeps the fast sampling interval for
          CONFIG_APP_IMPACT_LIFT_HOLD_SECONDS after the last such window.

config APP_IMPACT_LIFT_DEV_MG
        int "Lift detection: mean acceleration change in milli-g"
        default 30
        depends on APP_IMPACT_LIFT_DETECT
        help
          Smallest shift of a quiet 1 second window's mean acceleration
          magnitude, relative to the slow baseline, that counts as a lift
          starting or stopping. Typical lifts are 0.05 to 0.15 g.

config APP_IMPACT_LIFT_HOLD_SECONDS
        int "Lift detection: seconds of fast sampling after the last lift signal"
        default 300
        depends on APP_IMPACT_LIFT_DETECT

config APP_IMPACT_ACTIVITY_REPORT_INTERVAL_SECONDS
        int "Activity summary report interval in seconds"
        default 300
        help
          How often the module publishes an activity summary (peak g-force
          seen since the last report), regardless of whether it crossed the
          hard impact threshold. This gives the owner an ongoing record of
          how hard the dog has been playing/exerting - not just a log of
          hard-impact events - so mild-to-moderate over-exertion (e.g. an
          older dog straining after a squirrel) can be noticed even when
          nothing rose to the level of a reportable impact. Independent of
          CONFIG_APP_IMPACT_THRESHOLD_MG and CONFIG_APP_IMPACT_DEBOUNCE_MS,
          which govern the separate hard-impact alert path.
config APP_IMPACT_FREE_FALL
	bool "Free-fall detection"
	default y
	help
	  Detect free fall: acceleration magnitude stays near zero for a short
	  time (the device is falling or thrown), followed by a landing. Uses
	  the same accelerometer samples as impact detection. Reported as a
	  separate "FALL" message, with the free-fall duration and the peak g
	  seen while landing, so the receiver can tell a real fall from a
	  dropped-but-caught device.

config APP_IMPACT_FREE_FALL_THRESHOLD_MG
	int "Free-fall threshold in milli-g"
	depends on APP_IMPACT_FREE_FALL
	default 400
	help
	  Acceleration magnitude below this value counts as "falling".
	  Standing still reads about 1000 mg; true free fall reads near 0.

config APP_IMPACT_FREE_FALL_MIN_MS
	int "Minimum free-fall duration in milliseconds"
	depends on APP_IMPACT_FREE_FALL
	default 120
	help
	  The magnitude must stay below the threshold for at least this long.
	  Filters out bumps and potholes, which dip below the threshold only
	  briefly. A drop of 0.5 m lasts about 320 ms.

config APP_IMPACT_FREE_FALL_MAX_MS
	int "Maximum free-fall duration in milliseconds"
	depends on APP_IMPACT_FREE_FALL
	default 1500
	help
	  If the magnitude stays below the threshold longer than this, it is
	  treated as a sensor fault rather than a fall (1.5 s is about 11 m).

config APP_IMPACT_FREE_FALL_LANDING_WINDOW_MS
	int "Landing capture window in milliseconds"
	depends on APP_IMPACT_FREE_FALL
	default 500
	help
	  After free fall ends, keep sampling this long and report the highest
	  g seen, as the landing impact.

config APP_IMPACT_FREE_FALL_DEBOUNCE_MS
	int "Debounce after a reported fall in milliseconds"
	depends on APP_IMPACT_FREE_FALL
	default 5000
	help
	  Minimum time after a reported fall before another can be detected,
	  so one fall that bounces does not produce a flood of reports.

config APP_IMPACT_MANDOWN
	bool "Man-down check after a hard impact or fall"
	default y
	help
	  After a reported impact or fall, watch the next seconds: if the tracker stays still AND its
	  orientation changed (lying down compared with before), send a MAN_DOWN message. A slammed
	  door followed by walking, or sitting down in a car, does not send anything.

config APP_IMPACT_MANDOWN_SETTLE_MS
	int "Ignore time right after the event in milliseconds"
	depends on APP_IMPACT_MANDOWN
	default 3000
	help
	  Landing, bouncing and sliding after the event are ignored for this long.

config APP_IMPACT_MANDOWN_WATCH_MS
	int "Stillness watch time in milliseconds"
	depends on APP_IMPACT_MANDOWN
	default 45000
	help
	  How long the tracker must stay (almost) still after the settle time.

config APP_IMPACT_MANDOWN_STILL_MG
	int "Stillness threshold in milli-g"
	depends on APP_IMPACT_MANDOWN
	default 80
	help
	  A one-second window in which no axis varies by more than this counts as still.

config APP_IMPACT_MANDOWN_MAX_MOVING_WINDOWS
	int "Moving seconds tolerated during the watch"
	depends on APP_IMPACT_MANDOWN
	default 2
	help
	  A person who is down may twitch. More moving seconds than this cancels the watch.

config APP_IMPACT_MANDOWN_TILT_MIN_DEG
	int "Minimum orientation change in degrees"
	depends on APP_IMPACT_MANDOWN
	default 40
	help
	  The angle between the tracker's orientation just before the event and its orientation at the
	  end of the watch must be at least this, otherwise nothing is sent.

config APP_BMI270_LOG
	bool "BMI270 log-only bring-up (accelerometer +/-16 g and gyroscope)"
	depends on BMI270
	default n
	help
	  Periodically wakes the BMI270, takes a one second burst of accelerometer and gyroscope
	  readings and writes a one-line summary to the log. Sends nothing to the cloud and changes
	  no alerts. Use it to check the chip and measure its battery cost before building alerts on it.

config APP_BMI270_LOG_PERIOD_SECONDS
	int "Seconds between BMI270 bursts"
	depends on APP_BMI270_LOG
	default 10

module = APP_IMPACT
module-str = Impact detection module
source "subsys/logging/Kconfig.template.log_config"

endif # APP_IMPACT
```

## app/src/modules/orientation/Kconfig.orientation
```kconfig
#
# Copyright (c) 2025 Nordic Semiconductor
#
# SPDX-License-Identifier: LicenseRef-Nordic-5-Clause
#

menuconfig APP_ORIENTATION
	bool "Orientation module"
	depends on ADXL362 || ADXL367
	default n

if APP_ORIENTATION

config APP_ORIENTATION_THREAD_STACK_SIZE
	int "Thread stack size"
	default 1280

config APP_ORIENTATION_WATCHDOG_TIMEOUT_SECONDS
	int "Watchdog timeout"
	default 120
	help
	  Timeout in seconds for the orientation module watchdog.
	  The timeout given in this option covers both:
	    * Waiting for an incoming message in zbus_sub_wait_msg().
	    * Time spent processing the message, defined by
	      CONFIG_APP_ORIENTATION_MSG_PROCESSING_TIMEOUT_SECONDS.
	  Ensure that this value exceeds CONFIG_APP_ORIENTATION_MSG_PROCESSING_TIMEOUT_SECONDS.

config APP_ORIENTATION_MSG_PROCESSING_TIMEOUT_SECONDS
	int "Maximum message processing time"
	default 3
	help
	  Maximum time allowed for processing a single message in the module's state machine.
	  The value must be smaller than CONFIG_APP_ORIENTATION_WATCHDOG_TIMEOUT_SECONDS.

module = APP_ORIENTATION
module-str = ORIENTATION
source "subsys/logging/Kconfig.template.log_config"

endif # APP_ORIENTATION
```

## app/src/modules/pedometer/Kconfig.pedometer
```kconfig
#
# Copyright (c) 2025 Nordic Semiconductor
#
# SPDX-License-Identifier: LicenseRef-Nordic-5-Clause
#

menuconfig APP_PEDOMETER
	bool "Pedometer module"
	depends on ADXL362 || ADXL367
	default n

if APP_PEDOMETER

config APP_PEDOMETER_THREAD_STACK_SIZE
	int "Thread stack size"
	default 1280

config APP_PEDOMETER_SAMPLE_INTERVAL_MS
	int "Accelerometer poll interval for step detection, in milliseconds"
	default 50
	help
	  How often the accelerometer is sampled for the purpose of detecting steps.
	  This runs independently of, and much more frequently than, the app's
	  overall sample_interval (which only governs when accumulated steps are
	  reported to storage/cloud). 50 ms gives 20 Hz, enough headroom for a
	  dog's stride cadence without excessive current draw.

config APP_PEDOMETER_STEP_THRESHOLD_MM_S2
	int "Dynamic acceleration threshold for a step, in mm/s^2"
	default 1200
	help
	  Minimum deviation from standard gravity (in the magnitude of the
	  accelerometer vector) required to count a step. Expressed in
	  thousandths of m/s^2 to avoid floating point in Kconfig.
	  1200 mm/s^2 (1.2 m/s^2, ~0.12 g) is a reasonable starting point for a
	  collar/vest-mounted sensor; tune after watching real gait data.

config APP_PEDOMETER_STEP_DEBOUNCE_MS
	int "Minimum time between counted steps, in milliseconds"
	default 250
	help
	  Refractory period after a counted step during which no further step
	  is counted, to reject double-counting a single footfall's ringing.
	  250 ms caps the detectable cadence at 240 steps/min, well above any
	  real dog gait.

module = APP_PEDOMETER
module-str = PEDOMETER
source "subsys/logging/Kconfig.template.log_config"

endif # APP_PEDOMETER
```
